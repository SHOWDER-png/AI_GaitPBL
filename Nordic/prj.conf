## CMakeLists.txt
```
cmake_minimum_required(VERSION 3.20.0)
find_package(Zephyr REQUIRED HINTS $ENV{ZEPHYR_BASE})

project(nordic)

target_sources(app PRIVATE
    src/main.c
    src/fsr402.c
)
```

## sysbuild.conf
```
# Thingy:53 in NCS v3.4.0 still relies on the (deprecated) Partition Manager.
# Without this line the network-core build fails with
#   "undefined node label 's0_partition'"
SB_CONFIG_PARTITION_MANAGER=y

# Network core image: BLE radio firmware (ipc_radio) instead of the empty placeholder
SB_CONFIG_NETCORE_IPC_RADIO=y
SB_CONFIG_NETCORE_IPC_RADIO_BT_HCI_IPC=y

# Also produce one merged hex for the app + network core images
SB_CONFIG_MERGED_HEX_FILES=y
```

## prj.conf
```kconfig
CONFIG_STDOUT_CONSOLE=y
CONFIG_I2C=y
CONFIG_SENSOR=y
CONFIG_ADC=y

# Bluetooth LE + Nordic UART Service so the iPad / i.MX95 can connect
CONFIG_BT=y
CONFIG_BT_PERIPHERAL=y
CONFIG_BT_NUS=y
CONFIG_BT_DEVICE_NAME="thingy53_gait"
CONFIG_BT_L2CAP_TX_MTU=247
CONFIG_BT_BUF_ACL_RX_SIZE=251
CONFIG_BT_BUF_ACL_TX_SIZE=251

CONFIG_MAIN_STACK_SIZE=4096
```

## src/fsr402.c
```c
#include <errno.h>
#include <stdint.h>
#include <zephyr/kernel.h>
#include <zephyr/device.h>
#include <zephyr/drivers/adc.h>
#include <zephyr/devicetree.h>
#include <zephyr/sys/printk.h>

#include "fsr402.h"

/* Get ADC configuration from app.overlay */
#define FSR_NODE DT_PATH(zephyr_user)

static const struct adc_dt_spec fsr_adc =
    ADC_DT_SPEC_GET(FSR_NODE);

/* Initialize ADC */
int fsr402_init(void)
{
    if (!adc_is_ready_dt(&fsr_adc)) {
        printk("FSR ADC device not ready\n");
        return -ENODEV;
    }

    int err = adc_channel_setup_dt(&fsr_adc);

    if (err < 0) {
        printk("ADC setup failed: %d\n", err);
        return err;
    }

    printk("FSR402 initialized\n");

    return 0;
}

/* Read raw ADC value */
int fsr402_read(int16_t *raw_value)
{
    struct adc_sequence sequence = {
        .buffer = raw_value,
        .buffer_size = sizeof(*raw_value),
    };

    int err = adc_sequence_init_dt(&fsr_adc, &sequence);

    if (err < 0) {
        return err;
    }

    return adc_read_dt(&fsr_adc, &sequence);
}
```
